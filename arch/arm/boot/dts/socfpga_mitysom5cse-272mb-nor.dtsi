#include "socfpga_mitysom5cse.dtsi"

&qspi {
	flash1: nor@1 {
		#address-cells = <1>;
		#size-cells = <1>;
		compatible = "mt25qu02g", "jedec,spi-nor";
		reg = <1>;      /* chip select */
		spi-max-frequency = <108000000>;
		m25p,fast-read;
		page-size = <256>;
		block-size = <16>; /* 2^16, 64KB */
		cdns,read-delay = <4>;  /* delay value in read data capture register */
		cdns,tshsl-ns = <50>;
		cdns,tsd2d-ns = <50>;
		cdns,tchsh-ns = <4>;
		cdns,tslch-ns = <4>;
		partition@0 {
			/* 256MB for raw data. */
			label = "Data";
			reg = <0x0 0x10000000>;
		};
	};
};
